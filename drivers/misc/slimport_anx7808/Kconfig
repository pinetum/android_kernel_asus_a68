## drivers/misc/slimport_anx7808/Kconfig
```kconfig
config SLIMPORT_ANX7808
	bool "Analogix Slimport transmitter ANX7808 support"
	default n
	help
	  Slimport Transmitter is a HD video transmitter chip
	  over micro-USB connector for smartphone device.

config ANX7808_PM_SUPPORT
        bool "ANX7808_PM_SUPPORT"
        default y
        help
            Allows ANX7808_PM support
```

## drivers/sensors/Kconfig
```kconfig
menu "Sensors driver"

config SENSORS_PROXM
	tristate "PS ALS proxm_class support"
	depends on I2C=y
	help
	  ASUS SENSORS folder

config SENSORS_AP3212C
	tristate "PS ALS AP3212C support"
	depends on I2C=y
	help
	  ASUS SENSORS folder

config SENSORS_ADUX1020
	tristate "PS ALS ADUX1020 support"
	depends on I2C=y
	help
	  ASUS SENSORS folder

config SENSORS_CM32180
	tristate "PS ALS CM32180 support"
	depends on I2C=y
	help
	  ASUS SENSORS folder

config SENSORS_CM36283
	tristate "PS ALS CM36283 support"
	depends on I2C=y
	help
	  ASUS SENSORS folder

config SENSORS_CM3628
	tristate "PS ALS CM3628 support"
	depends on I2C=y
	help
	  ASUS SENSORS folder

config SENSORS_AL3010
	tristate "PS ALS AL3010 support"
	depends on I2C=y
	help
	  ASUS SENSORS folder

config SENSORS_AL3320
	tristate "PS ALS AL3320 support"
	depends on I2C=y
	help
	  ASUS SENSORS folder

endmenu
```

## drivers/video/msm/mhl8240/Kconfig
```kconfig
config FB_MSM_HDMI_MHL_8240
	depends on FB_MSM_HDMI_MSM_PANEL
	bool 'SI_MHL 8334 support '
	default n
	---help---
	  Support the HDMI to MHL conversion.
	  MHL (Mobile High-Definition Link) technology
	  uses USB connector to output HDMI content

config SII8240_DEBUG_DRIVER
	bool "SII8240 DEBUG"
	default n
	help
	  Allows to debug sii8240 driver

config SII8240_NO_TRANSCODE_MODE
	bool "SII8240 NO TRANSCODE"
	default y
	help
	  Allows no transcode mode

config SII8240_P03_DEMO
	bool "SII8240 P03 DEMO"
	default n
	help
	  Allows p03 demo

config SII8240_P03_DEMO_PP
	bool "SII8240 P03 DEMO PP "
	default n
	help
	  Allows p03 demo PP

config SII8240_VER68
	bool "SII8240_VER68"
	default y
	help
	  Allows SII8240_VER68

config SII8240_PM_SUPPORT
        bool "SII8240_PM_SUPPORT"
        default y
        help
            Allows SII8240_PM support
 
```
